# PIC32MX695F512L register map
Registers are 32-bit, access not given, reset 0x0 unless marked. A register's access mark holds for its fields unless they carry their own. Offsets are from the block's base; lines under a group give offsets from that group; [hi:lo] are bit positions; {n}, {i} and the like mark numbered series; 'fields as' and 'values as' point back to an identical list; <NAME> marks a mode.

## Memory map
0xBF800000 WDT size 0x10 — WDT peripheral
0xBF800200 RTCC size 0x60 — RTCC peripheral
0xBF800600 TMR1 size 0x30 — TMR1 peripheral
0xBF800800 TMR2 size 0x30 — TMR2 peripheral
0xBF800A00 TMR3 size 0x30 — TMR3 peripheral
0xBF800C00 TMR4 size 0x30 — TMR4 peripheral
0xBF800E00 TMR5 size 0x30 — TMR5 peripheral
0xBF802000 ICAP1 size 0x20 — ICAP1 peripheral
0xBF802200 ICAP2 size 0x20 — ICAP2 peripheral
0xBF802400 ICAP3 size 0x20 — ICAP3 peripheral
0xBF802600 ICAP4 size 0x20 — ICAP4 peripheral
0xBF802800 ICAP5 size 0x20 — ICAP5 peripheral
0xBF803000 OCMP1 size 0x30 — OCMP1 peripheral
0xBF803200 OCMP2 size 0x30 — OCMP2 peripheral
0xBF803400 OCMP3 size 0x30 — OCMP3 peripheral
0xBF803600 OCMP4 size 0x30 — OCMP4 peripheral
0xBF803800 OCMP5 size 0x30 — OCMP5 peripheral
0xBF805000 I2C3 size 0x70 — I2C3 peripheral
0xBF805100 I2C4 size 0x70 — I2C4 peripheral
0xBF805200 I2C5 size 0x70 — I2C5 peripheral
0xBF805300 I2C1 size 0x70 — I2C1 peripheral
0xBF805400 I2C2 size 0x70 — I2C2 peripheral
0xBF805800 SPI3 size 0x40 — SPI3 peripheral
0xBF805A00 SPI2 size 0x40 — SPI2 peripheral
0xBF805C00 SPI4 size 0x40 — SPI4 peripheral
0xBF805E00 SPI1 size 0x40 — SPI1 peripheral
0xBF806000 UART1 size 0x50 — UART1 peripheral
0xBF806200 UART4 size 0x50 — UART4 peripheral
0xBF806400 UART3 size 0x50 — UART3 peripheral
0xBF806600 UART6 size 0x50 — UART6 peripheral
0xBF806800 UART2 size 0x50 — UART2 peripheral
0xBF806A00 UART5 size 0x50 — UART5 peripheral
0xBF807000 PMP size 0x70 — PMP peripheral
0xBF809000 ADC10 size 0x170 — ADC10 peripheral
0xBF809800 CVR size 0x10 — CVR peripheral
0xBF80A000 CMP1 size 0x10 — CMP1 peripheral
0xBF80A010 CMP2 size 0x10 — CMP2 peripheral
0xBF80A060 CMP size 0x10 — CMP peripheral
0xBF80F000 OSC size 0x20 — OSC peripheral
0xBF80F200 CFG size 0x40 — CFG peripheral
0xBF80F400 NVM size 0x50 — NVM peripheral
0xBF80F600 RCON size 0x20 — RCON peripheral
0xBF880140 _DDPSTAT size 0x10 — _DDPSTAT peripheral
0xBF880170 _STRO size 0x10 — _STRO peripheral
0xBF880180 _APPO size 0x10 — _APPO peripheral
0xBF880190 _APPI size 0x10 — _APPI peripheral
0xBF881000 INT size 0x160 — INT peripheral
0xBF882000 BMX size 0x80 — BMX peripheral
0xBF883000 DMAC size 0x60 — DMAC peripheral
{0xBF883060+0xC0*n} DMAC{n} size 0xC0 (n=0..7) — DMAC{n} peripheral
0xBF884000 PCACHE size 0xD0 — PCACHE peripheral
0xBF885040 USB size 0x3C0 — USB peripheral
0xBF886000 PORTA size 0x40 — PORTA peripheral
0xBF886040 PORTB size 0x40 — PORTB peripheral
0xBF886080 PORTC size 0x40 — PORTC peripheral
0xBF8860C0 PORTD size 0x40 — PORTD peripheral
0xBF886100 PORTE size 0x40 — PORTE peripheral
0xBF886140 PORTF size 0x40 — PORTF peripheral
0xBF886180 PORTG size 0x70 — PORTG peripheral
0xBF889000 ETH size 0x330 — ETH peripheral

## Interrupts
0 CORE_TIMER (INT)
1 CORE_SOFTWARE_0 (INT)
2 CORE_SOFTWARE_1 (INT)
3 EXTERNAL_0 (INT)
4 TIMER_1 (INT)
5 INPUT_CAPTURE_1 (INT)
6 OUTPUT_COMPARE_1 (INT)
7 EXTERNAL_1 (INT)
8 TIMER_2 (INT)
9 INPUT_CAPTURE_2 (INT)
10 OUTPUT_COMPARE_2 (INT)
11 EXTERNAL_2 (INT)
12 TIMER_3 (INT)
13 INPUT_CAPTURE_3 (INT)
14 OUTPUT_COMPARE_3 (INT)
15 EXTERNAL_3 (INT)
16 TIMER_4 (INT)
17 INPUT_CAPTURE_4 (INT)
18 OUTPUT_COMPARE_4 (INT)
19 EXTERNAL_4 (INT)
20 TIMER_5 (INT)
21 INPUT_CAPTURE_5 (INT)
22 OUTPUT_COMPARE_5 (INT)
23 SPI_1 (INT)
24 I2C_1A (INT)
24 I2C_3 (INT)
24 SPI_1A (INT)
24 SPI_3 (INT)
24 UART_1 (INT)
24 UART_1A (INT)
25 I2C_1 (INT)
26 CHANGE_NOTICE (INT)
27 ADC (INT)
28 PMP (INT)
29 COMPARATOR_1 (INT)
30 COMPARATOR_2 (INT)
31 I2C_2A (INT)
31 I2C_4 (INT)
31 SPI_2 (INT)
31 SPI_2A (INT)
31 UART_2A (INT)
31 UART_3 (INT)
32 I2C_3A (INT)
32 I2C_5 (INT)
32 SPI_3A (INT)
32 SPI_4 (INT)
32 UART_2 (INT)
32 UART_3A (INT)
33 I2C_2 (INT)
34 FAIL_SAFE_MONITOR (INT)
35 RTCC (INT)
{n+36} DMA_{n} (INT) (n=0..7)
44 FCE (INT)
45 USB_1 (INT)
48 ETH (INT)
49 UART_1B (INT)
49 UART_4 (INT)
50 UART_2B (INT)
50 UART_6 (INT)
51 UART_3B (INT)
51 UART_5 (INT)
